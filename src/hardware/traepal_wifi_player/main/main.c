/* traepal_player - TraePal 电子蜘蛛状态显示版 (delta patch 压缩动画)
 * 功能: WiFi AP 接收状态命令, 播放电子蜘蛛表情动画 + 底部状态文字
 * 方案: raw partition 存 delta patch 压缩帧, ESP32 实时解码,
 *       PSRAM 单帧缓冲, 分块刷屏避免 SPI 队列满
 */
#include <stdio.h>
#include <string.h>
#include <stdlib.h>
#include "freertos/FreeRTOS.h"
#include "freertos/task.h"
#include "freertos/semphr.h"
#include "esp_log.h"
#include "esp_heap_caps.h"
#include "esp_lcd_panel_ops.h"
#include "esp_partition.h"
#include "nvs_flash.h"
#include "bsp/esp-bsp.h"
#include "wifi_tcp.h"

static const char *TAG = "TRAEPAL";

#define LCD_H_RES       466
#define LCD_V_RES       466
#define FRAME_BYTES     (LCD_H_RES * LCD_V_RES * 2)
#define FRAMES_PER_STATE 8
#define ANIM_INTERVAL_MS 120   /* ~8fps 动画间隔 */

/* Delta patch header entry (18 bytes, 与 gen_spider_frames.py 对应) */
typedef struct __attribute__((packed)) {
    uint8_t  index;
    uint8_t  isBase;
    uint16_t x, y, w, h;
    uint32_t offset;
    uint32_t size;
} frame_header_t;

/* 状态定义 */
typedef enum {
    STATE_IDLE = 0,    /* idle_ready */
    STATE_BUG,         /* bug_alert */
    STATE_FIX,         /* fix_success */
    STATE_COUNT
} traepal_state_t;

/* 状态名称 (显示用, 大写) */
static const char *s_state_names[STATE_COUNT] = {
    "IDLE READY",
    "BUG ALERT",
    "FIX SUCCESS"
};

static uint8_t *s_frame_buf;          /* PSRAM 单帧缓冲 (全屏) */
static uint8_t *s_patch_buf;          /* PSRAM delta patch 临时缓冲 */
static esp_lcd_panel_handle_t s_panel = NULL;
static const esp_partition_t *s_frames_part = NULL;
static frame_header_t s_headers[STATE_COUNT][FRAMES_PER_STATE];  /* delta patch header */
static traepal_state_t s_current_state = STATE_IDLE;
static SemaphoreHandle_t s_state_mutex;

/* RGB565 颜色 */
#define COLOR_WHITE     0xFFFF
#define COLOR_BLACK     0x0000
#define COLOR_RED       0xF800
#define COLOR_GREEN     0x07E0
#define COLOR_YELLOW    0xFFE0

/* ========== 点阵字体 (8x16, 2x 缩放 = 16x32) ========== */
static const uint8_t font8x16[96][16] = {
    {0x00,0x00,0x00,0x00,0x00,0x00,0x00,0x00,0x00,0x00,0x00,0x00,0x00,0x00,0x00,0x00},
    {0x00,0x00,0x18,0x3C,0x3C,0x3C,0x18,0x18,0x18,0x00,0x18,0x18,0x00,0x00,0x00,0x00},
    {0x00,0x63,0x63,0x63,0x22,0x22,0x00,0x00,0x00,0x00,0x00,0x00,0x00,0x00,0x00,0x00},
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    {0x00,0x00,0x00,0x00,0x00,0x00,0x00,0x00,0x00,0x00,0x00,0x00,0x00,0x00,0x00,0x00},
};

/* 2x 缩放画字符 (16x32 像素, 底部状态文字用) */
static void draw_char_small(uint16_t *buf, int x, int y, char c, uint16_t color)
{
    if (c >= 'a' && c <= 'z') c -= 32;
    if (c < 32 || c > 95) c = '?';
    const uint8_t *glyph = font8x16[c - 32];
    for (int row = 0; row < 16; row++) {
        for (int col = 0; col < 8; col++) {
            if (glyph[row] & (0x80 >> col)) {
                for (int dy = 0; dy < 2; dy++) {
                    for (int dx = 0; dx < 2; dx++) {
                        int px = x + col * 2 + dx;
                        int py = y + row * 2 + dy;
                        if (px >= 0 && px < LCD_H_RES && py >= 0 && py < LCD_V_RES) {
                            buf[py * LCD_H_RES + px] = color;
                        }
                    }
                }
            }
        }
    }
}

/* 画字符串 (2x 缩放, 居中) */
static void draw_text_small(uint16_t *buf, const char *text, int y_start, uint16_t color)
{
    int len = strlen(text);
    int char_w = 16;  /* 8 * 2 */
    int x = (LCD_H_RES - len * char_w) / 2;
    for (int i = 0; i < len; i++) {
        draw_char_small(buf, x + i * char_w, y_start, text[i], color);
    }
}

/* ========== raw 帧分区 (delta patch 格式) ========== */
static void frames_partition_init(void)
{
    s_frames_part = esp_partition_find_first(ESP_PARTITION_TYPE_DATA,
                                             ESP_PARTITION_SUBTYPE_DATA_UNDEFINED,
                                             "frames");
    if (!s_frames_part) {
        ESP_LOGE(TAG, "找不到 frames 分区");
        return;
    }
    ESP_LOGI(TAG, "frames 分区: offset=0x%x size=%uKB",
             (unsigned)s_frames_part->address,
             (unsigned)(s_frames_part->size / 1024));

    /* 读取 delta patch header (3 states × 8 frames × 18 bytes = 432 bytes) */
    size_t header_size = STATE_COUNT * FRAMES_PER_STATE * sizeof(frame_header_t);
    esp_err_t ret = esp_partition_read(s_frames_part, 0, s_headers, header_size);
    if (ret != ESP_OK) {
        ESP_LOGE(TAG, "读取 header 失败: %s", esp_err_to_name(ret));
        return;
    }
    ESP_LOGI(TAG, "delta patch header 加载完成 (%u bytes)", (unsigned)header_size);
    /* 打印第一帧信息确认 */
    ESP_LOGI(TAG, "state0 frame0: isBase=%d w=%d h=%d offset=%u size=%u",
             s_headers[0][0].isBase, s_headers[0][0].w, s_headers[0][0].h,
             (unsigned)s_headers[0][0].offset, (unsigned)s_headers[0][0].size);
}

/* 从 raw 分区读一帧 (支持 delta patch 解码)
 * - isBase=1: 全屏基础帧, 直接读取
 * - isBase=0, size>0: delta patch, 读取 bbox 区域覆盖到 framebuffer
 * - isBase=0, size=0: 无变化, 保持当前 framebuffer
 */
static bool load_frame(traepal_state_t state, int frame_idx)
{
    if (!s_frames_part) {
        ESP_LOGE(TAG, "frames 分区未初始化");
        return false;
    }
    frame_header_t *hdr = &s_headers[state][frame_idx];

    if (hdr->isBase) {
        /* 全屏基础帧 */
        esp_err_t ret = esp_partition_read(s_frames_part, hdr->offset,
                                           s_frame_buf, hdr->size);
        if (ret != ESP_OK) {
            ESP_LOGE(TAG, "读取基础帧失败: %s", esp_err_to_name(ret));
            return false;
        }
    } else if (hdr->size > 0) {
        /* delta patch: 读取 patch 数据, 覆盖到 framebuffer 的 bbox 区域 */
        if (hdr->size > FRAME_BYTES) {
            ESP_LOGE(TAG, "patch 太大: %u", (unsigned)hdr->size);
            return false;
        }
        esp_err_t ret = esp_partition_read(s_frames_part, hdr->offset,
                                           s_patch_buf, hdr->size);
        if (ret != ESP_OK) {
            ESP_LOGE(TAG, "读取 patch 失败: %s", esp_err_to_name(ret));
            return false;
        }
        /* 将 patch 数据覆盖到 framebuffer 的 bbox 区域 */
        uint16_t *dst = (uint16_t *)s_frame_buf + hdr->y * LCD_H_RES + hdr->x;
        uint16_t *src = (uint16_t *)s_patch_buf;
        for (int row = 0; row < hdr->h; row++) {
            memcpy(dst, src, hdr->w * 2);
            dst += LCD_H_RES;
            src += hdr->w;
        }
    }
    /* size == 0: 无变化, 保持当前 framebuffer */
    return true;
}

/* 分块刷新 framebuffer 到屏幕
 * 资源是 RGB565 little-endian, SPI 屏幕期望 big-endian, 需交换高低字节
 */
static void flush_framebuffer(void)
{
    const int strip_h = 4;
    uint16_t *buf = (uint16_t *)s_frame_buf;
    int chunk = 0;
    for (int y = 0; y < LCD_V_RES; y += strip_h) {
        int h = (y + strip_h > LCD_V_RES) ? (LCD_V_RES - y) : strip_h;
        int pixels = LCD_H_RES * h;
        uint16_t *strip = buf + y * LCD_H_RES;
        /* 交换每个像素的高低字节: little-endian → big-endian */
        for (int i = 0; i < pixels; i++) {
            uint16_t v = strip[i];
            strip[i] = (v >> 8) | (v << 8);
        }
        esp_lcd_panel_draw_bitmap(s_panel, 0, y, LCD_H_RES, y + h, strip);
        /* 每 8 块 (32 行) 让出 CPU 给 WiFi/TCP task */
        if (++chunk % 8 == 0) {
            vTaskDelay(pdMS_TO_TICKS(1));
        }
    }
}

/* 在帧上叠加底部状态文字条 */
static void overlay_status_text(traepal_state_t state)
{
    uint16_t *buf = (uint16_t *)s_frame_buf;
    /* 底部黑条 (高 40 像素) */
    for (int y = LCD_V_RES - 40; y < LCD_V_RES; y++) {
        for (int x = 0; x < LCD_H_RES; x++) {
            buf[y * LCD_H_RES + x] = COLOR_BLACK;
        }
    }
    /* 状态文字 (2x 缩放, 居中) */
    draw_text_small(buf, s_state_names[state], LCD_V_RES - 32, COLOR_WHITE);
}

/* 动画播放 task: 循环播放当前状态的帧 */
static void anim_task(void *arg)
{
    int frame = 0;
    traepal_state_t last_state = STATE_COUNT;  /* 强制首次加载基础帧 */
    while (1) {
        xSemaphoreTake(s_state_mutex, portMAX_DELAY);
        traepal_state_t st = s_current_state;
        xSemaphoreGive(s_state_mutex);

        /* 状态切换时重置到 frame 0, 确保从基础帧开始 */
        if (st != last_state) {
            frame = 0;
            last_state = st;
        }

        if (load_frame(st, frame)) {
            overlay_status_text(st);
            flush_framebuffer();
        }
        frame = (frame + 1) % FRAMES_PER_STATE;
        vTaskDelay(pdMS_TO_TICKS(ANIM_INTERVAL_MS));
    }
}

/* ========== WiFi 状态命令处理 ========== */
static traepal_state_t parse_state(const char *msg)
{
    /* 支持的命令: idle_ready / bug_alert / fix_success (大小写不敏感) */
    char lower[32];
    int i;
    for (i = 0; i < 31 && msg[i]; i++) {
        lower[i] = (msg[i] >= 'A' && msg[i] <= 'Z') ? msg[i] + 32 : msg[i];
    }
    lower[i] = '\0';

    if (strstr(lower, "idle")) return STATE_IDLE;
    if (strstr(lower, "bug")) return STATE_BUG;
    if (strstr(lower, "fix") || strstr(lower, "success")) return STATE_FIX;
    return STATE_IDLE;  /* 默认 */
}

static void on_wifi_msg(const char *msg, int len)
{
    ESP_LOGI(TAG, "收到状态命令: %s", msg);
    traepal_state_t st = parse_state(msg);
    xSemaphoreTake(s_state_mutex, portMAX_DELAY);
    s_current_state = st;
    xSemaphoreGive(s_state_mutex);
    ESP_LOGI(TAG, "切换状态: %s", s_state_names[st]);
}

/* ========== 主函数 ========== */
void app_main(void)
{
    ESP_LOGI(TAG, "========== TraePal Status Display ==========");

    /* 0. NVS */
    esp_err_t nvs_ret = nvs_flash_init();
    if (nvs_ret == ESP_ERR_NVS_NO_FREE_PAGES || nvs_ret == ESP_ERR_NVS_NEW_VERSION_FOUND) {
        ESP_ERROR_CHECK(nvs_flash_erase());
        ESP_ERROR_CHECK(nvs_flash_init());
    } else {
        ESP_ERROR_CHECK(nvs_ret);
    }

    /* 1. 屏幕 */
    bsp_display_config_t disp_cfg = { .max_transfer_sz = FRAME_BYTES };
    ESP_ERROR_CHECK(bsp_display_new(&disp_cfg, &s_panel, NULL));
    bsp_display_brightness_set(60);   /* AMOLED 低亮度黑色会偏紫, 用 60% 减轻边缘光晕 */
    ESP_LOGI(TAG, "屏幕初始化成功");

    /* 2. PSRAM 帧缓冲 + patch 缓冲 */
    s_frame_buf = heap_caps_malloc(FRAME_BYTES, MALLOC_CAP_SPIRAM);
    if (!s_frame_buf) {
        ESP_LOGE(TAG, "PSRAM 分配失败");
        return;
    }
    s_patch_buf = heap_caps_malloc(FRAME_BYTES, MALLOC_CAP_SPIRAM);
    if (!s_patch_buf) {
        ESP_LOGE(TAG, "PSRAM patch 缓冲分配失败");
        return;
    }

    /* 3. raw 帧分区 */
    frames_partition_init();

    /* 4. 状态互斥量 */
    s_state_mutex = xSemaphoreCreateMutex();

    /* 5. 启动动画 task (优先级 3, 低于 TCP server 的 5, 确保 WiFi 响应) */
    xTaskCreate(anim_task, "anim", 8192, NULL, 3, NULL);

    /* 6. WiFi */
    wifi_tcp_start(on_wifi_msg);

    ESP_LOGI(TAG, "========== 启动完成 ==========");
}
